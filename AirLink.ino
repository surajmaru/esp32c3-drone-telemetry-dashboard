/*
 * LOGICSURU AirLink  (single-file Arduino IDE version)
 * ESP32-C3 SuperMini  <->  BotWing F405 (Betaflight, MSP over UART)
 *
 * Arduino IDE setup:
 *   1. Install ESP32 board package (Espressif) via Boards Manager
 *   2. Library Manager -> install "WebSockets" by Markus Sattler
 *   3. Tools -> Board: "ESP32C3 Dev Module"
 *   4. Tools -> USB CDC On Boot: "Enabled"   (needed for Serial Monitor over USB)
 *   5. Upload. If upload fails, hold BOOT, tap RESET, release BOOT, then upload.
 *
 * Wiring (cross TX/RX):
 *   C3 GPIO20 (RX)  <-  FC TX6
 *   C3 GPIO21 (TX)  ->  FC RX6
 *   GND             --  GND
 *
 * Wi-Fi: "LOGICSURU-AirLink" / "airlink123"  ->  open http://192.168.4.1/
 *
 * Set SIMULATE to 1 to test the page with fake data and no FC attached.
 */

#include <Arduino.h>
#include <WiFi.h>
#include <WebServer.h>
#include <WebSocketsServer.h>
#include "esp_wifi.h"
#include "esp_system.h"

// ---------------- Config ----------------
#define SIMULATE 0   // 1 = fake data (bench test), 0 = read real FC over UART
#define LOW_TX_POWER 0   // set 1 if the Wi-Fi keeps dropping or restarting (shorter range)

static const char *AP_SSID = "LOGICSURU-AirLink";
static const char *AP_PASS = "airlink123";   // min 8 chars
static const int   AP_CHANNEL = 1;

static const int      FC_RX_PIN = 20;        // C3 RX  <- FC TX6
static const int      FC_TX_PIN = 21;        // C3 TX  -> FC RX6
static const uint32_t FC_BAUD   = 115200;    // must match UART6 MSP baud in Betaflight

static const uint32_t SEND_INTERVAL_MS = 100;   // websocket push rate (10 Hz)
static const uint32_t MSP_REQ_GAP_MS   = 20;    // min gap between MSP requests
static const uint32_t MSP_TIMEOUT_MS   = 80;    // give up waiting for a reply
static const uint32_t FC_LOST_MS       = 1500;  // no valid MSP reply for this long = FC link lost

// MSP v1 command IDs
#define MSP_STATUS    101
#define MSP_RC        105
#define MSP_RAW_GPS   106
#define MSP_ATTITUDE  108
#define MSP_ALTITUDE  109
#define MSP_ANALOG    110

HardwareSerial FCSerial(1);
WebServer server(80);
WebSocketsServer ws(81);

// ---------------- Dashboard (gzip-compressed, served from flash) ----------------
// The web page is compressed so it is small enough for the C3's Wi-Fi to send reliably.
const uint8_t DASHBOARD_GZ[] PROGMEM = {
  0x1f, 0x8b, 0x08, 0x00, 0x00, 0x00, 0x00, 0x00, 0x02, 0x03, 0xed, 0x3c, 0x69, 0x73, 0xdb, 0x46,
  0xb2, 0xdf, 0xf5, 0x2b, 0xc6, 0xf0, 0x5a, 0x01, 0x44, 0x00, 0x04, 0xc0, 0x43, 0x12, 0x28, 0x50,
  0xcf, 0x67, 0xe2, 0x2d, 0x27, 0x51, 0x49, 0x4a, 0xbc, 0x29, 0x3f, 0xd7, 0x16, 0x08, 0x0c, 0x48,
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  0x00, 0x00
};
const size_t DASHBOARD_GZ_LEN = sizeof(DASHBOARD_GZ);

void serveDashboard() {
  server.sendHeader("Content-Encoding", "gzip");
  server.sendHeader("Cache-Control", "no-cache");
  server.setContentLength(DASHBOARD_GZ_LEN);
  server.send(200, "text/html", "");              // headers only
  const uint8_t *p = DASHBOARD_GZ;
  size_t left = DASHBOARD_GZ_LEN;
  while (left) {                                  // send in small chunks
    size_t n = left > 1024 ? 1024 : left;
    server.sendContent_P((PGM_P)p, n);
    p += n; left -= n;
    delay(2);
  }
}

// ---------------- Telemetry state ----------------
struct Telemetry {
  bool     armed = false;
  uint16_t sensors = 0;
  float    vbat = 0;          // V
  float    amps = 0;          // A
  uint16_t mah = 0;
  int      rssiPct = -1;      // -1 = not provided
  float    roll = 0, pitch = 0;
  int      yaw = 0;
  uint16_t rc[4] = {0, 0, 0, 0};   // roll, pitch, yaw, throttle (as this FC reports them)
  uint8_t  fix = 0, sats = 0;
  double   lat = 0, lon = 0;
  int      gpsAlt = 0;        // m
  float    gpsSpeed = 0;      // km/h
  float    baroAlt = 0;       // m
};
Telemetry T;

uint32_t lastFcReply = 0;
uint32_t armedAt = 0;
uint32_t flightMs = 0;

// ---------------- MSP parser ----------------
static uint8_t  mspState = 0, mspSize = 0, mspCmd = 0, mspCrc = 0, mspIdx = 0;
static uint8_t  mspBuf[96];

static inline uint16_t u16(const uint8_t *p) { return p[0] | (p[1] << 8); }
static inline int16_t  i16(const uint8_t *p) { return (int16_t)u16(p); }
static inline uint32_t u32(const uint8_t *p) { return u16(p) | ((uint32_t)u16(p + 2) << 16); }
static inline int32_t  i32(const uint8_t *p) { return (int32_t)u32(p); }

void handleMsp(uint8_t cmd, const uint8_t *d, uint8_t n) {
  lastFcReply = millis();
  switch (cmd) {
    case MSP_STATUS:
      if (n >= 10) {
        T.sensors = u16(d + 4);
        uint32_t flags = u32(d + 6);
        bool nowArmed = flags & 1;           // bit 0 = ARM mode
        if (nowArmed && !T.armed) { armedAt = millis(); flightMs = 0; }
        T.armed = nowArmed;
      }
      break;
    case MSP_ANALOG:
      if (n >= 7) {
        T.vbat = d[0] / 10.0f;
        T.mah  = u16(d + 1);
        uint16_t r = u16(d + 3);
        T.rssiPct = r ? (int)(r * 100UL / 1023) : -1;
        T.amps = i16(d + 5) / 100.0f;
      }
      break;
    case MSP_ATTITUDE:
      if (n >= 6) {
        T.roll  = i16(d) / 10.0f;
        T.pitch = i16(d + 2) / 10.0f;
        T.yaw   = i16(d + 4);
      }
      break;
    case MSP_RC:
      if (n >= 8) for (int i = 0; i < 4; i++) T.rc[i] = u16(d + i * 2);
      break;
    case MSP_RAW_GPS:
      if (n >= 14) {
        T.fix = d[0];
        T.sats = d[1];
        T.lat = i32(d + 2) / 1e7;
        T.lon = i32(d + 6) / 1e7;
        T.gpsAlt = u16(d + 10);
        T.gpsSpeed = u16(d + 12) * 0.036f;   // cm/s -> km/h
      }
      break;
    case MSP_ALTITUDE:
      if (n >= 4) T.baroAlt = i32(d) / 100.0f;
      break;
  }
}

void mspFeed(uint8_t c) {
  switch (mspState) {
    case 0: if (c == '$') mspState = 1; break;
    case 1: mspState = (c == 'M') ? 2 : 0; break;
    case 2: mspState = (c == '>') ? 3 : 0; break;     // '!' (error reply) is dropped
    case 3: mspSize = c; mspCrc = c; mspIdx = 0; mspState = 4; break;
    case 4: mspCmd = c; mspCrc ^= c; mspState = mspSize ? 5 : 6; break;
    case 5:
      if (mspIdx < sizeof(mspBuf)) mspBuf[mspIdx] = c;
      mspIdx++;
      mspCrc ^= c;
      if (mspIdx >= mspSize) mspState = 6;
      break;
    case 6:
      if (c == mspCrc && mspSize <= sizeof(mspBuf)) handleMsp(mspCmd, mspBuf, mspSize);
      mspState = 0;
      break;
  }
}

void mspRequest(uint8_t cmd) {
  uint8_t pkt[6] = {'$', 'M', '<', 0, cmd, cmd};   // size 0, crc = 0 ^ cmd
  FCSerial.write(pkt, 6);
}

// Round-robin schedule: fast stuff (attitude, rc) more often than slow stuff.
static const uint8_t schedule[] = {
  MSP_ATTITUDE, MSP_RC, MSP_STATUS,
  MSP_ATTITUDE, MSP_RC, MSP_ANALOG,
  MSP_ATTITUDE, MSP_RC, MSP_RAW_GPS,
  MSP_ATTITUDE, MSP_RC, MSP_ALTITUDE,
};
static uint8_t  schedIdx = 0;
static bool     waiting = false;
static uint32_t lastReqAt = 0;

void mspPoll() {
  while (FCSerial.available()) {
    mspFeed((uint8_t)FCSerial.read());
    waiting = false;
  }
  uint32_t now = millis();
  bool timedOut = waiting && (now - lastReqAt > MSP_TIMEOUT_MS);
  if ((!waiting || timedOut) && (now - lastReqAt >= MSP_REQ_GAP_MS)) {
    mspState = 0;   // resync parser
    mspRequest(schedule[schedIdx]);
    schedIdx = (schedIdx + 1) % sizeof(schedule);
    lastReqAt = now;
    waiting = true;
  }
}

// ---------------- Simulation ----------------
void simulate() {
  float s = millis() / 1000.0f;
  lastFcReply = millis();
  T.sensors = 0x2B;                    // acc + baro + gps + gyro
  bool armed = ((int)(s / 15)) % 2 == 1;   // toggles every 15 s
  if (armed && !T.armed) { armedAt = millis(); flightMs = 0; }
  T.armed = armed;
  T.vbat = 12.6f - 0.002f * s;
  T.amps = armed ? 18 + 6 * sin(s) : 0.4f;
  T.mah = armed ? (uint16_t)(flightMs / 10) : T.mah;
  T.rssiPct = 70 + (int)(20 * sin(s / 3));
  T.roll = 25 * sin(s);
  T.pitch = 15 * sin(s * 0.7f);
  T.yaw = ((int)(s * 20)) % 360;
  T.rc[0] = 1500 + 300 * sin(s);
  T.rc[1] = 1500 + 300 * sin(s * 0.7f);
  T.rc[2] = 1500 + 200 * sin(s / 3);                         // yaw
  T.rc[3] = armed ? 1300 + 200 * sin(s / 2) : 1000;          // throttle
  T.fix = 2; T.sats = 9;
  T.lat = 19.0760 + 0.0001 * sin(s / 5);
  T.lon = 72.8777 + 0.0001 * cos(s / 5);
  T.gpsAlt = armed ? 40 + 30 * sin(s / 4) : 5;
  T.gpsSpeed = armed ? 35 + 20 * sin(s / 2) : 0;
  T.baroAlt = armed ? 38 + 30 * sin(s / 4) : 0;
}

// ---------------- WebSocket / HTTP ----------------
int wifiRssi() {
  wifi_sta_list_t list;
  if (esp_wifi_ap_get_sta_list(&list) == ESP_OK && list.num > 0) return list.sta[0].rssi;
  return 0;
}

void sendTelemetry() {
  if (ws.connectedClients() == 0) return;

  if (T.armed) flightMs = millis() - armedAt;
  bool fcOk = (millis() - lastFcReply) < FC_LOST_MS && lastFcReply != 0;

  char buf[512];
  snprintf(buf, sizeof(buf),
    "{\"t\":%lu,\"fc\":%d,\"arm\":%d,\"ft\":%lu,\"sen\":%u,"
    "\"v\":%.2f,\"a\":%.1f,\"mah\":%u,\"rssi\":%d,"
    "\"roll\":%.1f,\"pitch\":%.1f,\"yaw\":%d,"
    "\"rc\":[%u,%u,%u,%u],"
    "\"fix\":%u,\"sat\":%u,\"lat\":%.6f,\"lon\":%.6f,\"galt\":%d,\"spd\":%.1f,\"balt\":%.1f,"
    "\"wrssi\":%d,\"up\":%lu}",
    (unsigned long)millis(), fcOk, T.armed, (unsigned long)(flightMs / 1000), T.sensors,
    T.vbat, T.amps, T.mah, T.rssiPct,
    T.roll, T.pitch, T.yaw,
    T.rc[0], T.rc[1], T.rc[2], T.rc[3],
    T.fix, T.sats, T.lat, T.lon, T.gpsAlt, T.gpsSpeed, T.baroAlt,
    wifiRssi(), (unsigned long)(millis() / 1000));
  ws.broadcastTXT(buf);
}

void onWsEvent(uint8_t num, WStype_t type, uint8_t *payload, size_t len) {
  if (type == WStype_CONNECTED) Serial.printf("[ws] client %u connected\n", num);
  if (type == WStype_DISCONNECTED) Serial.printf("[ws] client %u disconnected\n", num);
}

// ---------------- Setup / loop ----------------
void setup() {
  Serial.begin(115200);
  delay(300);
  Serial.println("\nLOGICSURU AirLink starting...");
  Serial.print("Last reset reason: ");
  switch (esp_reset_reason()) {
    case ESP_RST_POWERON:  Serial.println("power-on"); break;
    case ESP_RST_SW:       Serial.println("software reset"); break;
    case ESP_RST_PANIC:    Serial.println("CRASH (panic)"); break;
    case ESP_RST_INT_WDT:  Serial.println("CRASH (interrupt watchdog)"); break;
    case ESP_RST_TASK_WDT: Serial.println("CRASH (task watchdog)"); break;
    case ESP_RST_WDT:      Serial.println("CRASH (watchdog)"); break;
    case ESP_RST_BROWNOUT: Serial.println("BROWNOUT (power dipped)"); break;
    default:               Serial.println((int)esp_reset_reason()); break;
  }

  FCSerial.begin(FC_BAUD, SERIAL_8N1, FC_RX_PIN, FC_TX_PIN);

  WiFi.mode(WIFI_AP);
  WiFi.setSleep(false);
  WiFi.softAP(AP_SSID, AP_PASS, AP_CHANNEL, 0, 2);
#if LOW_TX_POWER
  // Some SuperMini clones are unstable at full TX power (weak antenna / USB power).
  WiFi.setTxPower(WIFI_POWER_8_5dBm);
#endif

  Serial.print("AP IP: ");
  Serial.println(WiFi.softAPIP());

  server.on("/", HTTP_GET, serveDashboard);
  server.onNotFound([]() { server.send(404, "text/plain", "Not found"); });
  server.begin();

  ws.begin();
  ws.onEvent(onWsEvent);

#if SIMULATE
  Serial.println("SIMULATION MODE - no FC data is read");
#endif
}

void loop() {
  server.handleClient();
  ws.loop();

#if SIMULATE
  simulate();
#else
  mspPoll();
#endif

  static uint32_t lastSend = 0;
  if (millis() - lastSend >= SEND_INTERVAL_MS) {
    lastSend = millis();
    sendTelemetry();
  }
}
